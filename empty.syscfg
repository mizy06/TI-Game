/**
 * AI AGENTS: Do not edit this file directly. There is no validation or error feedback when
 * editing manually — mistakes will be silent until the file is loaded in SysConfig.
 * Use the SysConfig MCP server instead to make changes with immediate error reporting.
 *
 * These arguments were used when this file was generated. They will be automatically applied on subsequent loads
 * via the GUI or CLI. Run CLI with '--help' for additional information on how to override these arguments.
 * @cliArgs --device "MSPM0G350X" --part "Default" --package "LQFP-64(PM)" --product "mspm0_sdk@2.11.00.07"
 * @v2CliArgs --device "MSPM0G3507" --package "LQFP-64(PM)" --product "mspm0_sdk@2.11.00.07"
 * @versions {"tool":"1.28.1+4785"}
 */

/**
 * Import the modules used in this configuration.
 *
 * 零基础说明：SysConfig 是 TI 的外设配置生成器。这里的 JavaScript 风格
 * 语句不会在 MCU 上运行，而是让工具生成 ti_msp_dl_config.c/.h。ADC12
 * 负责采样，TIMER 周期触发 ADC，UART 与电脑通信，GPIO 是用户按键，
 * DAC12 负责自己产生测试波形，SYSCTL 管理系统时钟。addInstance() 表示
 * 创建该外设的一个具体实例。
 */
const ADC12  = scripting.addModule("/ti/driverlib/ADC12", {}, false);
const ADC121 = ADC12.addInstance();
const GPIO   = scripting.addModule("/ti/driverlib/GPIO", {}, false);
const GPIO1  = GPIO.addInstance();
const SYSCTL = scripting.addModule("/ti/driverlib/SYSCTL");
const TIMER  = scripting.addModule("/ti/driverlib/TIMER", {}, false);
const TIMER1 = TIMER.addInstance();
const UART   = scripting.addModule("/ti/driverlib/UART", {}, false);
const UART1  = UART.addInstance();
/* DAC12 是单实例模块，没有 addInstance()，直接配置模块本身即可。 */
const DAC12  = scripting.addModule("/ti/driverlib/DAC12");

/**
 * Write custom configuration values to the imported modules.
 */
/* ADC12_0：12 位 ADC，时钟二分频；由外部事件（下方 TIMER_0）触发。
 * adcMem0chansel=CHAN_2 对应最终建议引脚 PA25。repeatMode 使每次定时器
 * 事件都可产生新转换；结果装入 MEM0 后触发中断，由 empty.c 读取。 */
ADC121.$name               = "ADC12_0";
ADC121.sampClkDiv          = "DL_ADC12_CLOCK_DIVIDE_2";
ADC121.trigSrc             = "DL_ADC12_TRIG_SRC_EVENT";
ADC121.adcMem0chansel      = "DL_ADC12_INPUT_CHAN_2";
ADC121.adcMem0trig         = "DL_ADC12_TRIGGER_MODE_TRIGGER_NEXT";
ADC121.repeatMode          = true;
ADC121.powerDownMode       = "DL_ADC12_POWER_DOWN_MODE_MANUAL";
ADC121.subChanID           = 1;
ADC121.enabledInterrupts   = ["DL_ADC12_INTERRUPT_MEM0_RESULT_LOADED"];
ADC121.adcPin2Config.$name = "ti_driverlib_gpio_GPIOPinGeneric2";

/* DAC12_0：板载测试波形发生器，输出固定落在 PA15（LQFP-64 的 PINCM37，
 * 这也是该封装上 DAC0 唯一可用的模拟输出脚）。
 * - dacOutputPinEn=true 打开输出脚；dacAmplifier="ON" 打开输出缓冲，
 *   这样一根杜邦线直接短接到 PA25 就能被 ADC 采到，不需要外接运放；
 * - dacFIFOEn=false 表示不使用 FIFO：固件在定时器中断里直接写 DATA0，
 *   每写一次输出立刻更新，实现 20 kHz 的任意波形回放；
 * - dacSampleTimerEn=false 关闭 DAC 自带的采样率发生器，因为节拍由
 *   TIMER_0 的 ZERO 事件统一提供，保证"产生"和"采集"严格同源。
 * 参考电压沿用默认的 VDDA/VSSA：与 ADC 的参考完全一致，于是 DAC 码值
 * 经过模拟链路再被 ADC 采回时，VDDA 的绝对误差会在两端相互抵消。 */
DAC12.dacFIFOEn        = false;
DAC12.dacOutputPinEn   = true;
DAC12.dacAmplifier     = "ON";
DAC12.dacSampleTimerEn = false;
/* 输出脚的自动命名会与 UART 的 TX 脚撞名（都叫 GPIOPinGeneric0），
 * 因此显式指定一个未被占用的编号。 */
DAC12.OutPinConfig.$name = "ti_driverlib_gpio_GPIOPinGeneric3";

/* Board 模块保留调试系统 SWD 引脚，供 XDS110 下载和单步调试。 */
const Board = scripting.addModule("/ti/driverlib/Board", {}, false);

/* GPIO_GRP_0.PIN_0 是输入按键；empty.c 运行时再启用上拉和迟滞。 */
GPIO1.$name                       = "GPIO_GRP_0";
GPIO1.associatedPins[0].$name     = "PIN_0";
GPIO1.associatedPins[0].direction = "INPUT";

/* 使用 SDK 默认系统时钟方案；CPUCLK_FREQ 由生成头文件提供给延时计算。 */
SYSCTL.forceDefaultClkConfig = true;
/* DAC12 的模拟部分需要一个中间频率外设时钟（MFPCLK）才能工作：SysConfig
 * 会对"MFPCLK 未使能却添加了 DAC12"直接报错。MFPCLK 只供模拟外设使用，
 * 取 SYSOSC，不影响 CPUCLK=32 MHz，因此 TIMER_0 的 20 kHz 采样率不变。
 * 这里刻意不打开 clockTreeEn：一旦打开，SysConfig 会接管整棵时钟树，
 * 从而不再生成原有的 ULPCLK/MCLK 分频语句。保持默认时钟方案可以让
 * 这次改动只增加 MFPCLK 和 DAC12，其余寄存器序列与改动前逐字节一致。 */
SYSCTL.MFPCLKEn     = true;
SYSCTL.MFPCLKSource = "SYSOSC";

/* TIMER_0 周期为 0.05 ms，即每秒 1/0.00005=20000 次。ZERO 事件发布到
 * 通道 1，ADC 订阅这个事件，因此无需 CPU 软件启动每次转换。
 * 自激（RT）时同一个 ZERO 中断还负责把下一个 DAC 码写进 DATA0，于是
 * "产生波形"和"采集波形"共用同一个 20 kHz 节拍，第 k 个 ADC 点恒等于
 * 第 k 个 DAC 码，帧内不需要任何对齐。 */
TIMER1.$name                       = "TIMER_0";
TIMER1.interrupts                  = ["ZERO"];
TIMER1.timerPeriod                 = "0.05 ms";
TIMER1.timerMode                   = "PERIODIC";
TIMER1.timerClkPrescale            = 1;
TIMER1.event1PublisherChannel      = 1;
TIMER1.event1ControllerInterruptEn = ["ZERO_EVENT"];

UART1.$name             = "UART_0";
/* UART profile 包含波特率等通信参数。SysConfig 当前建议 PA0/PA1；empty.c
 * 还在运行时把 UART0 映射到 PA10/PA11，以适配 LaunchPad XDS110 回传串口。 */
UART1.profile           = "CONFIG_PROFILE_1";
UART1.txPinConfig.$name = "ti_driverlib_gpio_GPIOPinGeneric0";
UART1.rxPinConfig.$name = "ti_driverlib_gpio_GPIOPinGeneric1";

/**
 * Pinmux solution for unlocked pins/peripherals. This ensures that minor changes to the automatic solver in a future
 * version of the tool will not impact the pinmux you originally saw.  These lines can be completely deleted in order to
 * re-solve from scratch.
 *
 * suggestSolution 锁定自动求解器当前选中的外设实例与物理引脚。若在 GUI
 * 中改引脚，应让 SysConfig 重新求解，不要只改某一行而留下资源冲突。
 */
ADC121.peripheral.$suggestSolution           = "ADC0";
ADC121.peripheral.adcPin2.$suggestSolution   = "PA25";
Board.peripheral.$suggestSolution            = "DEBUGSS";
Board.peripheral.swclkPin.$suggestSolution   = "PA20";
Board.peripheral.swdioPin.$suggestSolution   = "PA19";
DAC12.peripheral.$suggestSolution            = "DAC0";
DAC12.peripheral.OutPin.$suggestSolution     = "PA15";
GPIO1.associatedPins[0].pin.$suggestSolution = "PB13";
SYSCTL.peripheral.$suggestSolution           = "SYSCTL";
TIMER1.peripheral.$suggestSolution           = "TIMA0";
UART1.peripheral.$suggestSolution            = "UART0";
UART1.peripheral.rxPin.$suggestSolution      = "PA1";
UART1.peripheral.txPin.$suggestSolution      = "PA0";
