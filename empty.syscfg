/**
 *
 * @cliArgs --device "MSPM0G350X" --part "Default" --package "LQFP-64(PM)" --product "mspm0_sdk@2.11.00.07"
 * @versions {"tool":"1.28.1+4785"}
 */

/**
 * Import the modules used in this configuration.
 */
const ADC12  = scripting.addModule("/ti/driverlib/ADC12", {}, false);
const ADC121 = ADC12.addInstance();
const GPIO   = scripting.addModule("/ti/driverlib/GPIO", {}, false);
const GPIO1  = GPIO.addInstance();
const SYSCTL = scripting.addModule("/ti/driverlib/SYSCTL");
const TIMER  = scripting.addModule("/ti/driverlib/TIMER", {}, false);
const TIMER1 = TIMER.addInstance();
const UART   = scripting.addModule("/ti/driverlib/UART", {}, false);
const UART1  = UART.addInstance();

/**
 * Write custom configuration values to the imported modules.
 */
ADC121.$name               = "ADC12_0";
ADC121.sampClkSrc          = "DL_ADC12_CLOCK_HFCLK";
ADC121.sampClkDiv          = "DL_ADC12_CLOCK_DIVIDE_2";
ADC121.trigSrc             = "DL_ADC12_TRIG_SRC_EVENT";
ADC121.adcMem0chansel      = "DL_ADC12_INPUT_CHAN_2";
ADC121.adcMem0trig         = "DL_ADC12_TRIGGER_MODE_TRIGGER_NEXT";
ADC121.repeatMode          = true;
ADC121.powerDownMode       = "DL_ADC12_POWER_DOWN_MODE_MANUAL";
ADC121.subChanID           = 1;
/* One half-word DMA transfer per MEM0 conversion. FIFO stays disabled;
 * the acquisition-only firmware stores one contiguous 8192-sample block. */
ADC121.configureDMA       = true;
ADC121.enableFIFO         = false;
ADC121.enableDMA          = true;
ADC121.sampCnt            = 1;
ADC121.enabledDMATriggers = ["DL_ADC12_DMA_MEM0_RESULT_LOADED"];
ADC121.enabledInterrupts  = ["DL_ADC12_INTERRUPT_DMA_DONE",
                             "DL_ADC12_INTERRUPT_UNDERFLOW"];
ADC121.adcPin2Config.$name = "ti_driverlib_gpio_GPIOPinGeneric2";

ADC121.DMA_CHANNEL.peripheral.$assign = "DMA_CH0";
ADC121.DMA_CHANNEL.$name              = "DMA_CH0";
ADC121.DMA_CHANNEL.addressMode       = "f2b";
ADC121.DMA_CHANNEL.srcLength         = "HALF_WORD";
ADC121.DMA_CHANNEL.dstLength         = "HALF_WORD";
ADC121.DMA_CHANNEL.dstIncDec         = "INCREMENT";

const Board = scripting.addModule("/ti/driverlib/Board", {}, false);

GPIO1.$name                       = "GPIO_GRP_0";
GPIO1.associatedPins[0].$name     = "PIN_0";
GPIO1.associatedPins[0].direction = "INPUT";
GPIO1.associatedPins[0].internalResistor = "PULL_UP";

/* 原装 LaunchPad Y2=40 MHz；固定使用外部参考，采集期间不切换时钟。 */
SYSCTL.forceDefaultClkConfig = false;
SYSCTL.enableSYSOSCFCL = false;
SYSCTL.useHFCLK_Manual = true;
SYSCTL.HFCLKSource = "HFXT";
SYSCTL.HFCLK_Freq = 40000000;
SYSCTL.HFCLKMonitor = true;
SYSCTL.HFXTStartup = 10;
SYSCTL.MCLKSource = "HSCLK";
SYSCTL.HSCLKSource = "SYSPLLCLK2X";
SYSCTL.SYSPLLSource = "HFCLK";
SYSCTL.SYSPLL_Pdiv = 1;
SYSCTL.SYSPLL_Qdiv = 2;
SYSCTL.SYSPLL_CLK2XEn = true;
SYSCTL.SYSPLL_CLK2XDiv = 4;
SYSCTL.enableWorkaround_SYSPLL_ERR_01 = true;

TIMER1.$name                       = "TIMER_0";
TIMER1.timerPeriod                 = "0.05 ms";
TIMER1.timerMode                   = "PERIODIC";
TIMER1.timerClkPrescale            = 1;
TIMER1.event1PublisherChannel      = 1;
TIMER1.event1ControllerInterruptEn = ["ZERO_EVENT"];

UART1.$name             = "UART_0";
UART1.profile           = "CONFIG_PROFILE_1";
UART1.enableInternalLoopback = false;
UART1.txPinConfig.$name = "ti_driverlib_gpio_GPIOPinGeneric0";
UART1.rxPinConfig.$name = "ti_driverlib_gpio_GPIOPinGeneric1";

/**
 * Pinmux solution for unlocked pins/peripherals. This ensures that minor changes to the automatic solver in a future
 * version of the tool will not impact the pinmux you originally saw.  These lines can be completely deleted in order to
 * re-solve from scratch.
 */
ADC121.peripheral.$suggestSolution           = "ADC0";
ADC121.peripheral.adcPin2.$suggestSolution   = "PA25";
Board.peripheral.$suggestSolution            = "DEBUGSS";
Board.peripheral.swclkPin.$suggestSolution   = "PA20";
Board.peripheral.swdioPin.$suggestSolution   = "PA19";
GPIO1.associatedPins[0].pin.$suggestSolution = "PB13";
SYSCTL.peripheral.$suggestSolution           = "SYSCTL";
SYSCTL.peripheral.hfxInPin.$suggestSolution   = "PA5";
SYSCTL.peripheral.hfxOutPin.$suggestSolution  = "PA6";
TIMER1.peripheral.$suggestSolution           = "TIMA0";
UART1.peripheral.$suggestSolution            = "UART0";
UART1.peripheral.rxPin.$suggestSolution      = "PA11";
UART1.peripheral.txPin.$suggestSolution      = "PA10";
